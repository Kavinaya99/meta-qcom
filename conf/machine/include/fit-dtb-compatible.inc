## conf/machine/iq-8275-evk.conf
```bitbake
#@TYPE: Machine
#@NAME: Qualcomm IQ-8275 Evaluation Kit (EVK) based on QCS8275
#@DESCRIPTION: Machine configuration for Qualcomm IQ-8275 Evaluation Kit (EVK)

require conf/machine/include/qcom-qcs8300.inc

MACHINE_FEATURES += "efi pci"

QCOM_DTB_DEFAULT ?= "monaco-evk"

KERNEL_DEVICETREE ?= " \
                      qcom/monaco-evk.dtb \
                      qcom/monaco-evk-camera-imx577.dtbo \
                      qcom/monaco-evk-camx.dtbo \
                      "

MACHINE_ESSENTIAL_EXTRA_RRECOMMENDS += " \
    packagegroup-iq-8275-evk-firmware \
    packagegroup-iq-8275-evk-hexagon-dsp-binaries \
    qcom-fastcv-binaries-qcs8300-ride-dsp \
"

QCOM_CDT_FILE = "cdt_qcs8275_iq_8275_evk_pro_sku"
QCOM_BOOT_FILES_SUBDIR = "qcs8300"
QCOM_PARTITION_FILES_SUBDIR ?= "partitions/iq-8275-evk/ufs"

QCOM_BOOT_FIRMWARE = "firmware-qcom-boot-qcs8300"

KERNEL_TECH_DTBOS[monaco-evk] = "monaco-evk-camera-imx577.dtbo; monaco-evk-camx.dtbo"
FIT_DTB_COMPATIBLE[monaco-evk] = "qcom,qcs8275-iot"
FIT_DTB_DTBO_COMPATIBLE[monaco-evk] = "qcom,qcs8275-iot-camx; qcom,qcs8275-iot-camx"
```

## conf/machine/iq-9075-evk.conf
```bitbake
#@TYPE: Machine
#@NAME: Qualcomm IQ-9075 Evaluation Kit (EVK) based on QCS9075
#@DESCRIPTION: Machine configuration for Qualcomm IQ-9075 Evaluation Kit (EVK)

require conf/machine/include/qcom-qcs9100.inc

MACHINE_FEATURES += "efi pci"

QCOM_DTB_DEFAULT ?= "lemans-evk"

KERNEL_DEVICETREE ?= " \
                      qcom/lemans-evk.dtb \
                      qcom/lemans-evk-camera-csi1-imx577.dtbo \
                      qcom/lemans-evk-camx.dtbo \
                      "

MACHINE_ESSENTIAL_EXTRA_RRECOMMENDS += " \
    packagegroup-iq-9075-evk-firmware \
    packagegroup-iq-9075-evk-hexagon-dsp-binaries \
    qcom-fastcv-binaries-sa8775p-ride-dsp \
"

QCOM_CDT_FILE = "cdt_rb8_core_kit"
QCOM_BOOT_FILES_SUBDIR = "qcs9100"
QCOM_PARTITION_FILES_SUBDIR ?= "partitions/iq-9075-evk/ufs"

QCOM_BOOT_FIRMWARE = "firmware-qcom-boot-qcs9100"

KERNEL_TECH_DTBOS[lemans-evk] = "lemans-evk-camera-csi1-imx577.dtbo; lemans-evk-camx.dtbo"
FIT_DTB_COMPATIBLE[lemans-evk] = "qcom,qcs9075-iot qcom,qcs9075v2-iot"
FIT_DTB_DTBO_COMPATIBLE[lemans-evk] = "qcom,qcs9075-iot-camx qcom,qcs9075v2-iot-camx; qcom,qcs9075-iot-camx qcom,qcs9075v2-iot-camx"
```
