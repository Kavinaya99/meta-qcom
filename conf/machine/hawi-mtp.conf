## conf/machine/hawi-mtp.conf
```bitbake
#@TYPE: Machine
#@NAME: Qualcomm Hawi MTP
#@DESCRIPTION: Machine configuration for Qualcomm Hawi (SM8975) MTP

require conf/machine/include/qcom-hawi.inc

MACHINE_FEATURES += "tpm2"


KERNEL_DEVICETREE ?= " \
    qcom/hawi-mtp.dtb \
    "

MACHINE_ESSENTIAL_EXTRA_RRECOMMENDS += " \
    packagegroup-hawi-mtp-firmware \
    packagegroup-hawi-mtp-hexagon-dsp-binaries \
"

QCOM_BOOT_FILES_SUBDIR = "hawi"
QCOM_PARTITION_FILES_SUBDIR ?= "partitions/hawi-mtp/ufs"
QCOM_BOOT_FIRMWARE = "firmware-qcom-boot-hawi"

# Bootloader configuration
ABL_SIGNATURE_VERSION ?= "v7"
```
